/**
 * @cliArgs --board "/ti/boards/CC1352P1_LAUNCHXL" --product "simplelink_cc13x2_26x2_sdk@4.40.04.04"
 * @versions {"data":"2021010520","timestamp":"2021010520","tool":"1.7.0+1746","templates":null}
 */

/**
 * Import the modules used in this configuration.
 */
const CCFG     = scripting.addModule("/ti/devices/CCFG");
const custom   = scripting.addModule("/ti/devices/radioconfig/custom");
const rfdesign = scripting.addModule("/ti/devices/radioconfig/rfdesign");
const Display  = scripting.addModule("/ti/display/Display");
const Display1 = Display.addInstance();
const GPIO     = scripting.addModule("/ti/drivers/GPIO");
const GPIO1    = GPIO.addInstance();
const GPIO2    = GPIO.addInstance();
const GPIO3    = GPIO.addInstance();
const RF       = scripting.addModule("/ti/drivers/RF");
const RTOS     = scripting.addModule("/ti/drivers/RTOS");
const SPI      = scripting.addModule("/ti/drivers/SPI");
const SPI1     = SPI.addInstance();
const UART2    = scripting.addModule("/ti/drivers/UART2", {}, false);
const UART21   = UART2.addInstance();

/**
 * Write custom configuration values to the imported modules.
 */
CCFG.xoscCapArray             = true;
CCFG.xoscCapArrayDelta        = 0xC1;
CCFG.enableBootloader         = true;
CCFG.enableBootloaderBackdoor = true;
CCFG.dioBootloaderBackdoor    = 15;
CCFG.levelBootloaderBackdoor  = "Active low";
CCFG.ccfgTemplate.$name       = "ti_devices_CCFGTemplate0";

custom.prop8                                              = ["custom868"];
custom.radioConfigcustom868.phyType868                    = "2gfsk50kbps";
custom.radioConfigcustom868.carrierFrequency              = 868.0000;
custom.radioConfigcustom868.highPA                        = true;
custom.radioConfigcustom868.$name                         = "RF_Custom_Setting";
custom.radioConfigcustom868.codeExportConfig.$name        = "ti_devices_radioconfig_code_export_param0";
custom.radioConfigcustom868.codeExportConfig.paExport     = "combined";
custom.radioConfigcustom868.codeExportConfig.symGenMethod = "Legacy";

Display1.$name                    = "CONFIG_Display_0";
Display1.$hardware                = system.deviceData.board.components.XDS110UART;
Display1.uart.$name               = "CONFIG_UART_0";
Display1.uart.txPinInstance.$name = "CONFIG_PIN_0";
Display1.uart.rxPinInstance.$name = "CONFIG_PIN_1";

GPIO1.$hardware         = system.deviceData.board.components.LED_RED;
GPIO1.$name             = "CONFIG_GPIO_RLED";
GPIO1.pinInstance.$name = "CONFIG_PIN_RLED";

GPIO2.$hardware         = system.deviceData.board.components.LED_GREEN;
GPIO2.$name             = "CONFIG_GPIO_GLED";
GPIO2.pinInstance.$name = "CONFIG_PIN_GLED";

GPIO3.$name              = "CONFIG_SSI0_CS";
GPIO3.initialOutputState = "High";
GPIO3.gpioPin.$assign    = "boosterpack.18";
GPIO3.pinInstance.$name  = "CONFIG_PIN_5";

RF.$hardware = system.deviceData.board.components["SKY13317-373LF"];

SPI1.$name                 = "CONFIG_SPI_MASTER";
SPI1.defaultTxBufferValue  = "0xFF";
SPI1.$hardware             = system.deviceData.board.components.LP_SPI;
SPI1.sclkPinInstance.$name = "CONFIG_PIN_2";
SPI1.misoPinInstance.$name = "CONFIG_PIN_3";
SPI1.mosiPinInstance.$name = "CONFIG_PIN_4";

UART21.$name               = "CONFIG_UART2_0";
UART21.uart.$assign        = "UART1";
UART21.uart.txPin.$assign  = "boosterpack.9";
UART21.uart.rxPin.$assign  = "boosterpack.5";
UART21.txPinInstance.$name = "CONFIG_PIN_6";
UART21.rxPinInstance.$name = "CONFIG_PIN_7";

/**
 * Pinmux solution for unlocked pins/peripherals. This ensures that minor changes to the automatic solver in a future
 * version of the tool will not impact the pinmux you originally saw.  These lines can be completely deleted in order to
 * re-solve from scratch.
 */
Display1.uart.uart.$suggestSolution       = "UART0";
Display1.uart.uart.txPin.$suggestSolution = "boosterpack.4";
Display1.uart.uart.rxPin.$suggestSolution = "boosterpack.3";
GPIO1.gpioPin.$suggestSolution            = "boosterpack.39";
GPIO2.gpioPin.$suggestSolution            = "boosterpack.40";
RF.rfAntennaPin0.$suggestSolution         = "41";
RF.rfAntennaPin1.$suggestSolution         = "42";
RF.rfAntennaPin2.$suggestSolution         = "43";
SPI1.spi.$suggestSolution                 = "SSI0";
SPI1.spi.sclkPin.$suggestSolution         = "boosterpack.7";
SPI1.spi.misoPin.$suggestSolution         = "boosterpack.14";
SPI1.spi.mosiPin.$suggestSolution         = "boosterpack.15";
SPI1.spi.dmaRxChannel.$suggestSolution    = "DMA_CH3";
SPI1.spi.dmaTxChannel.$suggestSolution    = "DMA_CH4";
